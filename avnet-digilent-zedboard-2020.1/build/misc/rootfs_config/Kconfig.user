## avnet-digilent-zedboard-2020.1/build/misc/rootfs_config/Kconfig.user
```kconfig
menu "apps " 
config gpio-demo  
	 bool "gpio-demo"
	 help
	gpio-demo application
	
config peekpoke  
	 bool "peekpoke"
	 help
	peekpoke application
	
endmenu
menu "modules " 
config launcher-driver  
	 bool "launcher-driver"
	 help
	Recipe for  build an external launcher-driver Linux kernel module
	
endmenu
menu "user packages " 
endmenu
```
